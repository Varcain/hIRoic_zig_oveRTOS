## nuttx/stm32f746g-discovery_defconfig
```kconfig
# hIRoic NuttX overlay for STM32F746G-Discovery
# Board-specific peripherals for audio and filesystem.

# Stack sizes — init task runs ove_main which does FS mount + IR loading
CONFIG_INIT_STACKSIZE=8192
CONFIG_DEFAULT_TASK_STACKSIZE=4096
CONFIG_SCHED_HPWORKSTACKSIZE=8192

# SD card via SDMMC
CONFIG_STM32F7_SDMMC1=y
CONFIG_MMCSD_SDIO=y
CONFIG_FS_FAT=y

# Audio: SAI2 I2S + WM8994 codec
CONFIG_DRIVERS_AUDIO=y
CONFIG_AUDIO_I2S=y
CONFIG_AUDIO_WM8994=y
CONFIG_AUDIO_DRIVER_SPECIFIC_BUFFERS=y
CONFIG_AUDIO_FORMAT_RAW=y
CONFIG_WM8994_NUM_BUFFERS=8
CONFIG_WM8994_BUFFER_SIZE=1024
CONFIG_STM32F7_DMA2=y
CONFIG_STM32F7_SAI2=y
CONFIG_STM32F7_SAI2_A=y
CONFIG_STM32F7_SAI2_B=y
CONFIG_STM32F7_SAI2_B_SYNC_WITH_A=y
CONFIG_I2C=y
CONFIG_STM32F7_I2C3=y
```
